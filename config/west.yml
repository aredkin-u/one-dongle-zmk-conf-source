## config/west.yml
```yaml
manifest:
  remotes:
    - name: zmkfirmware
      url-base: https://github.com/zmkfirmware
    - name: carrefinho                            # <--- add this for prospector
      url-base: https://github.com/carrefinho     # <--- and this for prospector
  projects:
    - name: zmk
      remote: zmkfirmware
      revision: main
      import: app/west.yml
    - name: prospector-zmk-module                 # <--- for prospector
      remote: carrefinho                          # <---for prospector
      revision: main                              # <---for prospector      
  self:
    path: config
```
